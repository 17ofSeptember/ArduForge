// ─────────────────────────────────────────────
//  Generated by ArduForge
//  Project: Ultrasonic Parking Sensor
//  Board:   Arduino Uno (arduino:avr:uno)
// ─────────────────────────────────────────────

#include "AwryLink.h"

float distance = 0.0f;

// Variables exposed to the ArduForge dashboard.
static const AwryVar AWRY_VARS[] = {
  { "distance", (void *)&distance, AWRY_FLOAT, true },
};
static const char AWRY_HASH[] = "338f7e78";

float _af_distance_n9(uint8_t triggerPin, uint8_t echoPin);

void setup() {
  Serial.begin(115200);
  awrylink_begin(AWRY_VARS, 1, AWRY_HASH);
  pinMode(6, INPUT);
  pinMode(7, OUTPUT);
  // nothing connected
}

void loop() {
  awrylink_poll();
  static unsigned long _af_last_n4 = 0;
  if (millis() - _af_last_n4 >= (unsigned long)(100)) {
    _af_last_n4 = millis();
    distance = _af_distance_n9(7, 6);
    if ((distance < 30)) {
      tone(8, 1200, 60);
    } else {
      noTone(8);
    }
  }
}

float _af_distance_n9(uint8_t triggerPin, uint8_t echoPin) {
  // Standard HC-SR04 sequence: 10µs trigger, then time the echo.
  digitalWrite(triggerPin, LOW);
  delayMicroseconds(2);
  digitalWrite(triggerPin, HIGH);
  delayMicroseconds(10);
  digitalWrite(triggerPin, LOW);

  // 30ms timeout keeps a missing echo from stalling the whole loop.
  unsigned long echoUs = pulseIn(echoPin, HIGH, 30000UL);
  if (echoUs == 0) return -1.0f; // nothing came back
  return echoUs / 58.0f;
}
